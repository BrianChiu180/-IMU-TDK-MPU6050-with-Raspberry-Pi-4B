## mpu6050_20261108 (Include Cal and INT)/Kconfig
```kconfig
# SPDX-License-Identifier: GPL-2.0-only

#
# Light sensors
#
# When adding new entries keep the list in alphabetical order

menu "IMU SENSOR"

config MPU6050
	tristate "MPU6050 IMU sensor"
	depends on I2C
        default m
	help
	  Say Y here if you want to build a driver for the TDK MPU6050
	  ambient light sensor.

	  To compile this driver as a module, choose M here: the
	  module will be called mpu6050.


endmenu
```
